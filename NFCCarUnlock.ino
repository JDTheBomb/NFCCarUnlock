/**
 * ----------------------------------------------------------------------------
 * This is a MFRC522 library example; see https://github.com/miguelbalboa/rfid
 * for further details and other examples.
 *
 * NOTE: The library file MFRC522.h has a lot of useful info. Please read it.
 *
 * Released into the public domain.
 * ----------------------------------------------------------------------------
 * This sample shows how to read and write data blocks on a MIFARE Classic PICC
 * (= card/tag).
 *
 * BEWARE: Data will be written to the PICC, in sector #1 (blocks #4 to #7).
 *
 *
 * Typical pin layout used:
 * -----------------------------------------------------------------------------------------
 *             MFRC522      Arduino       Arduino   Arduino    Arduino          Arduino
 *             Reader/PCD   Uno/101       Mega      Nano v3    Leonardo/Micro   Pro Micro
 * Signal      Pin          Pin           Pin       Pin        Pin              Pin
 * -----------------------------------------------------------------------------------------
 * RST/Reset   RST          9             5         D9         RESET/ICSP-5     RST
 * SPI SS      SDA(SS)      10            53        D10        10               10
 * SPI MOSI    MOSI         11 / ICSP-4   51        D11        ICSP-4           16
 * SPI MISO    MISO         12 / ICSP-1   50        D12        ICSP-1           14
 * SPI SCK     SCK          13 / ICSP-3   52        D13        ICSP-3           15
 *
 * More pin layouts for other boards can be found here: https://github.com/miguelbalboa/rfid#pin-layout
 *
 */

#include <SPI.h>
#include <MFRC522.h>

#define RST_PIN         5           // Configurable, see typical pin layout above
#define SS_PIN          53          // Configurable, see typical pin layout above

MFRC522 mfrc522(SS_PIN, RST_PIN);   // Create MFRC522 instance.

MFRC522::MIFARE_Key key;
MFRC522::Uid MyUID = {0x04,0x09,0x53,0x84,0xB3};
byte UID[4] = {0x09,0x53,0x84,0xB3};
MFRC522::MIFARE_Key Keys [32] = {
  {0x96,0x28,0x99,0x94,0x64,0xA1},
  {0xC1,0x74,0xDC,0xE1,0xA5,0xC4},
  {0x3F,0x4F,0x4E,0xF5,0x51,0x72},
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  {0x23,0x25,0x61,0x8f,0x71,0xda}
};
byte BlockData[48][16]={
  {0x09,0x53,0x84,0xB3,0x6D,0x08,0x04,0x00,0x62,0x63,0x64,0x65,0x66,0x67,0x68,0x69},
  {0xc6,0x0d,0x19,0x86,0x71,0x30,0x34,0xd4,0xbc,0x18,0xd5,0x4a,0x41,0x83,0x4c,0xe6},
  {0xc5,0xc6,0x38,0x87,0x79,0x3f,0x15,0x20,0xaa,0x3a,0xb5,0x25,0x60,0x01,0x97,0x7c},
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  {0x9a,0x50,0x90,0x2a,0x93,0x6f,0xcd,0x8c,0x99,0x32,0x27,0xf2,0xf2,0xd8,0xc8,0x0e}
};



/**
 * Initialize.
 */
void setup() {
    
    Serial.begin(9600); // Initialize serial communications with the PC
    while (!Serial);    // Do nothing if no serial port is opened (added for Arduinos based on ATMEGA32U4)
    SPI.begin();        // Init SPI bus
    mfrc522.PCD_Init(); // Init MFRC522 card

    // Prepare the key (used both as key A and as key B)
    // using FFFFFFFFFFFFh which is the default at chip delivery from the factory
    for (byte i = 0; i < 6; i++) {
        key.keyByte[i] = 0xFF;
    }
    //Serial.print(F("Using key (for A and B):"));
    //dump_byte_array(key.keyByte, MFRC522::MF_KEY_SIZE);
    randomSeed(analogRead(5));
}

/**
 * Main loop.
 */
void loop() {
    // Reset the loop if no new card present on the sensor/reader. This saves the entire process when idle.
    if ( ! mfrc522.PICC_IsNewCardPresent())
        return;

    // Select one of the cards
    if ( ! mfrc522.PICC_ReadCardSerial())
        return;

    for(byte i = 0; i < mfrc522.uid.size;i++){
      if(MyUID.uidByte[i] != mfrc522.uid.uidByte[i]){
        return;
      }
    }

    if (mfrc522.PICC_GetType(mfrc522.uid.sak) != MFRC522::PICC_TYPE_MIFARE_1K) {
        Serial.println(F("This sample only works with MIFARE Classic cards."));
        return;
    }

    // In this sample we use the second sector,
    // that is: sector #1, covering block #4 up to and including block #7
    byte KeyChoice = random(15);
    MFRC522::StatusCode status;
    byte buffer[18];
    byte size = sizeof(buffer);


    // Authenticate using key A
    status = (MFRC522::StatusCode) mfrc522.PCD_Authenticate(MFRC522::PICC_CMD_MF_AUTH_KEY_A, KeyChoice*4, &Keys[KeyChoice*2], &(mfrc522.uid));
    if (status != MFRC522::STATUS_OK) {
        Serial.print(F("PCD_Authenticate() failed: "));
        Serial.println(mfrc522.GetStatusCodeName(status));
        return;
    }

    // Read data from the block
    for(byte i=KeyChoice*4;i<(KeyChoice*4);i++){
      Serial.print("Letter I: ");
      Serial.println(i);
      
      status = (MFRC522::StatusCode) mfrc522.MIFARE_Read(i, buffer, &size);
      if (status != MFRC522::STATUS_OK) {
          Serial.print(F("MIFARE_Read() failed: "));
          Serial.println(mfrc522.GetStatusCodeName(status));
      }

      Serial.print(F("Data in block")); Serial.println(F(":"));
      dump_byte_array(buffer, 16); Serial.println();

      for(byte j=0;j<16;j++){
        Serial.print("KeyChoice: ");
        Serial.println(KeyChoice*4);
        dump_byte_array(BlockData[(KeyChoice*4)+i],16);
        if(BlockData[(KeyChoice*4)+i][j]!=buffer[j]){
          Serial.println("Test");
          return;
        }
      }
    }
    Serial.println("Verified");
    // Halt PICC
    mfrc522.PICC_HaltA();
    // Stop encryption on PCD
    mfrc522.PCD_StopCrypto1();
}

/**
 * Helper routine to dump a byte array as hex values to Serial.
 */
void dump_byte_array(byte *buffer, byte bufferSize) {
    for (byte i = 0; i < bufferSize; i++) {
        Serial.print(buffer[i] < 0x10 ? " 0" : " ");
        Serial.print(buffer[i], HEX);
    }
}
